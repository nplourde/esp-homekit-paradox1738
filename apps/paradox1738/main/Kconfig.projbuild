## apps/paradox1738/main/Kconfig.projbuild
```kconfig
menu "Example Configuration"

    config PARADOX_WEB_SERVER
        bool "Enable the authenticated web server"
        default y
        help
            Start the port 80 HTTP server for the bridge login page and API.
            Disable to omit the server while retaining HomeKit and Wi-Fi.

    config PARADOX_EVENT_LOG_CAPACITY
        int "Panel event log capacity"
        range 8 256
        default 64
        help
            Number of decoded panel events retained in RAM for the web API.

    config PARADOX_RAW_TAP_CAPACITY
        int "Raw panel UART tap size (bytes)"
        range 256 16384
        default 2048
        help
            Size of the byte-for-byte copy of everything received on the panel
            UART that is kept in RAM. The authenticated web debug endpoints
            expose it as hex, so the link framing can be investigated over
            Wi-Fi instead of with a serial cable.

    config EXAMPLE_USE_HARDCODED_SETUP_CODE
        bool "Use hard-coded setup code"
        default y
        help
            HomeKit does not recommend having the setup code programmed in the accessory as is.
            Instead, it expects setup info (salt-verifier pair) generated for the given setup code.
            Use this option only for testing purposes. For production, the setup info should be
            used.

    config EXAMPLE_SETUP_CODE
        string "HomeKit Setup Code"
        default "111-22-333"
        depends on EXAMPLE_USE_HARDCODED_SETUP_CODE
        help
            Setup code to be used for HomeKit pairing, if hard-coded setup code is enabled.

    config EXAMPLE_SETUP_ID
        string "HomeKit Setup Id"
        default "ES32"
        depends on EXAMPLE_USE_HARDCODED_SETUP_CODE
        help
            Setup id to be used for HomeKot pairing, if hard-coded setup code is enabled.

    menu "Paradox 1738 link"

        config PARADOX_SIMULATOR
            bool "Replay recorded panel frames instead of reading UART2"
            default n
            help
                Feed the event decoder from a table of frames captured from the
                real panel, and leave UART2 unused. Lets the firmware be run and
                smoke-tested with no alarm panel wired up. Do not enable in a
                build that is expected to report real sensor states.

    endmenu

    menu "Paradox 1738 tests"

        config PARADOX_LINK_SELFTEST
            bool "Run the Paradox link init/deinit self-test at boot"
            default n
            help
                Call paradox1738_link_selftest() instead of paradox1738_init(): it
                brings the link up, calls paradox1738_deinit() twice (T1.6) and
                re-initialises. Watch the log for "LINK SELFTEST: PASS".

        config PARADOX_CONFIG_SELFTEST
            bool "Run the Paradox config NVS self-test at boot"
            default n
            help
                Use an isolated NVS namespace to test config save/reboot/load,
                schema migration and corrupt-blob fallback. The test reboots
                automatically between its phases.

        config PARADOX_OTA_ROLLBACK_SELFTEST
            bool "Reboot a pending OTA image before validation"
            depends on BOOTLOADER_APP_ROLLBACK_ENABLE
            default n
            help
                Reboot immediately when an OTA image is pending verification so
                the bootloader rollback path can be tested on hardware.

        endmenu

endmenu
```

## apps/paradox1738/sdkconfig.defaults
```kconfig
CONFIG_PARTITION_TABLE_CUSTOM=y
CONFIG_PARTITION_TABLE_CUSTOM_FILENAME="partitions_hap.csv"
CONFIG_BOOTLOADER_APP_ROLLBACK_ENABLE=y
CONFIG_FREERTOS_UNICORE=y
CONFIG_LWIP_MAX_SOCKETS=16
CONFIG_LWIP_SO_REUSE=y
CONFIG_LWIP_MAX_ACTIVE_TCP=12
CONFIG_LWIP_MAX_LISTENING_TCP=12
CONFIG_LWIP_UDP_RECVMBOX_SIZE=10
CONFIG_MBEDTLS_HARDWARE_MPI=y
CONFIG_MBEDTLS_HARDWARE_SHA=n
CONFIG_ESP_TASK_WDT_INIT=n
CONFIG_LWIP_AUTOIP=y
CONFIG_ESPTOOLPY_FLASHSIZE_4MB=y
CONFIG_LWIP_AUTOIP_RATE_LIMIT_INTERVAL=60
CONFIG_APP_WIFI_USE_PROVISIONING=y
CONFIG_APP_WIFI_USE_UNIFIED_PROVISIONING=y
CONFIG_APP_WIFI_PROV_TRANSPORT_BLE=y
CONFIG_HAP_HTTP_SERVER_PORT=8080
CONFIG_BT_ENABLED=y
CONFIG_BTDM_CTRL_MODE_BLE_ONLY=y
CONFIG_BT_NIMBLE_ENABLED=y
```
