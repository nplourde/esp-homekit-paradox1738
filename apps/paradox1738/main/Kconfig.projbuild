## apps/paradox1738/main/Kconfig.projbuild
```kconfig
menu "Example Configuration"

    config EXAMPLE_USE_HARDCODED_SETUP_CODE
        bool "Use hard-coded setup code"
        default y
        help
            HomeKit does not recommend having the setup code programmed in the accessory as is.
            Instead, it expects setup info (salt-verifier pair) generated for the given setup code.
            Use this option only for testing purposes. For production, the setup info should be
            used.

    config EXAMPLE_SETUP_CODE
        string "HomeKit Setup Code"
        default "111-22-333"
        depends on EXAMPLE_USE_HARDCODED_SETUP_CODE
        help
            Setup code to be used for HomeKit pairing, if hard-coded setup code is enabled.

    config EXAMPLE_SETUP_ID
        string "HomeKit Setup Id"
        default "ES32"
        depends on EXAMPLE_USE_HARDCODED_SETUP_CODE
        help
            Setup id to be used for HomeKot pairing, if hard-coded setup code is enabled.

    menu "Paradox 1738 link"

        config PARADOX_SIMULATOR
            bool "Replay recorded panel frames instead of reading UART2"
            default n
            help
                Feed the event decoder from a table of frames captured from the
                real panel, and leave UART2 unused. Lets the firmware be run and
                smoke-tested with no alarm panel wired up. Do not enable in a
                build that is expected to report real sensor states.

    endmenu

endmenu
```
